## boards/shields/nice_oled/Kconfig.shield
```kconfig
config SHIELD_NICE_OLED
    def_bool $(shields_list_contains,nice_oled)

config SHIELD_NICE_EPAPER
    def_bool $(shields_list_contains,nice_epaper)

config SHIELD_NICE_EPAPER_NEW
    def_bool $(shields_list_contains,nice_epaper_new)
```
